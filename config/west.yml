## config/west.yml
```yaml
manifest:
  remotes:
    - name: zmkfirmware
      url-base: https://github.com
    - name: cormoran
      url-base: https://github.com
  projects:
    - name: zmk
      remote: cormoran
      revision: main+custom-studio-protocol
      import:
        file: app/west.yml
    - name: zmk-module-ble-management
      remote: cormoran
      revision: main
  self:
    path: config
```
